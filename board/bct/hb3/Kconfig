## board/bct/hb3/Kconfig
```kconfig
if TARGET_HB3

config SYS_BOARD
	default "hb3"

config SYS_VENDOR
	default "bct"

config SYS_SOC
	default "mx6"

config SYS_CONFIG_NAME
	default "hb3"

endif
```

## board/bct/rm3/Kconfig
```kconfig
if TARGET_RM3

config SYS_BOARD
	default "rm3"

config SYS_VENDOR
	default "bct"

config SYS_SOC
	default "mx6"

config SYS_CONFIG_NAME
	default "rm3"

endif
```

## configs/hb3spl_defconfig
```kconfig
CONFIG_TARGET_HB3=y
CONFIG_SYS_EXTRA_OPTIONS="SPL,SYS_USE_SPINOR,SYS_BOOT_NAND,SPL_DMA_SUPPORT,SPL_SPI_FLASH_SUPPORT,SPL_SPI_SUPPORT,SPL_SPI_LOAD,DEFAULT_FDT_FILE=\"bctrm3.dtb\",DDR_MB=1024,IMX_CONFIG=board/bct/hb3/hb3.cfg,MX6Q"
CONFIG_SPL=y
CONFIG_ARM=y
CONFIG_DM=y
CONFIG_DM_THERMAL=y
```

## configs/re3_defconfig
```kconfig
CONFIG_TARGET_RE3=y
CONFIG_SYS_EXTRA_OPTIONS="DEFAULT_FDT_FILE=\"bctre3.dtb\",DDR_MB=1024,IMX_CONFIG=board/bct/re3/re3.cfg,MX6Q"
CONFIG_ARM=y
CONFIG_DM=y
CONFIG_DM_THERMAL=y
```

## configs/re3android_defconfig
```kconfig
CONFIG_TARGET_RE3=y
CONFIG_SYS_EXTRA_OPTIONS="ANDROID_SUPPORT,SPL,SYS_USE_SPINOR,DEFAULT_FDT_FILE=\"bctre3.dtb\",DDR_MB=1024,IMX_CONFIG=board/bct/re3/re3.cfg,MX6Q"
CONFIG_SPL=y
CONFIG_ARM=y
CONFIG_DM=y
CONFIG_DM_THERMAL=y
```

## configs/re3spl_defconfig
```kconfig
CONFIG_SPL=y
CONFIG_SYS_EXTRA_OPTIONS="SPL,SYS_USE_SPINOR,SYS_BOOT_NAND,SPL_DMA_SUPPORT,SPL_SPI_FLASH_SUPPORT,SPL_SPI_SUPPORT,SPL_SPI_LOAD,DEFAULT_FDT_FILE=\"bctre3.dtb\",DDR_MB=1024,IMX_CONFIG=board/bct/re3/re3.cfg,MX6Q"
CONFIG_TARGET_RE3=y
CONFIG_ARM=y
CONFIG_DM=y
CONFIG_DM_THERMAL=y
```

## configs/rm3_defconfig
```kconfig
CONFIG_TARGET_RM3=y
CONFIG_SYS_EXTRA_OPTIONS="DEFAULT_FDT_FILE=\"bctrm3.dtb\",DDR_MB=1024,IMX_CONFIG=board/bct/rm3/rm3.cfg,MX6Q"
CONFIG_ARM=y
CONFIG_DM=y
CONFIG_DM_THERMAL=y
```
